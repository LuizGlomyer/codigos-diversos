#define a 13
#define b 12
#define c 11
#define d 10
#define buzz 9

void setup() {
  // put your setup code here, to run once:
  pinMode(a, OUTPUT);
  pinMode(b, INPUT_PULLUP);
  pinMode(c, OUTPUT);
  pinMode(d, INPUT_PULLUP);
  pinMode(buzz, OUTPUT);
  digitalWrite(a, HIGH);
  //digitalWrite(b, LOW);
    Serial.begin(500000);

}

void loop() {
  // put your main code here, to run repeatedly:

  if(digitalRead(b)== LOW){
    tone(buzz, 500);
    while(digitalRead(d) == HIGH){
      digitalWrite(c, !digitalRead(c));
      digitalWrite(a, !digitalRead(a));
      
      tone(buzz, 1900, 100);   //Define a frequência em 1440
      delay(100);
      tone(buzz, 900, 100);
      delay(100);
      tone(buzz, 1500, 150);
      delay(100);
      tone(buzz, 1200, 170);
      delay(100);
      Serial.println("................................................................................................................................................................................................................................................................................................................................................................................................................................................................................................................................................................................................................................................................................................................................................................................................................................................................................................................................................................................................................................................................................................................................................................................................................................................");


      
      delay(1000);         
    }
  }

  if(digitalRead(d) == LOW){
    noTone(buzz);
    while(digitalRead(b) == HIGH){
      
    }
  }



  /*else{
    digitalWrite(a, LOW);
  }*/
  
}
